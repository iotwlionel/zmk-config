#include "keypad_2x3-layouts.dtsi"

/ {
    chosen {
        zmk,physical-layout = &default_layout;
    };

    kscan0: kscan_direct {
        compatible = "zmk,kscan-gpio-direct";
        label = "KSCAN";
        input-gpios
            = <&pro_micro 0 (GPIO_ACTIVE_LOW | GPIO_PULL_UP)> // RC(0,0)
            , <&pro_micro 1 (GPIO_ACTIVE_LOW | GPIO_PULL_UP)> // RC(0,1)
            , <&pro_micro 2 (GPIO_ACTIVE_LOW | GPIO_PULL_UP)> // RC(0,2)
            , <&pro_micro 3 (GPIO_ACTIVE_LOW | GPIO_PULL_UP)> // RC(0,3)
            , <&pro_micro 4 (GPIO_ACTIVE_LOW | GPIO_PULL_UP)> // RC(0,4)
            , <&pro_micro 5 (GPIO_ACTIVE_LOW | GPIO_PULL_UP)>; // RC(0,5)
    };
};
