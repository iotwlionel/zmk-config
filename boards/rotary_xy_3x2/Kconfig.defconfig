## boards/shields/keypad_2x3/Kconfig.defconfig
```kconfig
if SHIELD_KEYPAD_2X3

config ZMK_KEYBOARD_NAME
    default "keypad_2x3"

endif # SHIELD_KEYPAD_2X3
```

## boards/shields/rotary6k/Kconfig.defconfig
```kconfig
if SHIELD_ROTARY6K

config ZMK_KEYBOARD_NAME
    default "rotary6k"

endif # SHIELD_ROTARY6K
```

## boards/shields/rotary_xy_2x3/Kconfig.defconfig
```kconfig
if SHIELD_ROTARY_XY_2X3

config ZMK_KEYBOARD_NAME
    default "RotaryXY 2x3"

endif # SHIELD_ROTARY_XY_2X3
```

## boards/shields/sample/Kconfig.defconfig
```kconfig
if SHIELD_SAMPLE

config ZMK_KEYBOARD_NAME
    default "sample"

endif # SHIELD_SAMPLE
```
